/*
 * Application layer: MP3 file player.
 * See app/player.h.
 */
#define LOG_LOCAL_LEVEL ESP_LOG_INFO    /* keep per-50-frame decode tracing out unless explicitly set to DEBUG at runtime */
#include "player.h"
#include "hardware/audio.h"

#include <stdio.h>
#include <string.h>
#include <strings.h>
#include <dirent.h>

#include "mp3dec.h"
#include "freertos/FreeRTOS.h"
#include "freertos/task.h"
#include "esp_attr.h"
#include "esp_log.h"

/* Read buffer for MP3 stream data. */
#define MP3_READ_CHUNK  (4 * 1024)
/* Worst-case decoded PCM: MPEG1 Layer III, 2 channels, 1152 samples/frame. */
#define MP3_PCM_MAX     (2 * 1152 * 2)

static const char *TAG = "player";

/* Built-in track compiled into the firmware via EMBED_FILES.
 * The symbols below are generated by the build system from "Test.mp3". */
#define EMBEDDED_PREFIX "(ROM)"
extern const uint8_t _binary_Test_mp3_start[];
extern const uint8_t _binary_Test_mp3_end[];

static TaskHandle_t s_task;
static player_state_t s_state = PLAYER_IDLE;

static char s_path[192];        /* full path: /sdcard/<name> */
static char s_name[MP3_NAME_LEN];
static bool s_stop_req;
static bool s_pause_req;
static bool s_new_req;
static bool s_new_embedded;       /* true => play the built-in ROM track */
static char s_new_path[192];
static char s_new_name[MP3_NAME_LEN];
static uint32_t s_dbg_frames;          /* decode-frame counter for debug logs */
static uint32_t s_dbg_rate;            /* samplerate captured from 1st frame */

/* Abstract data source: either a file on the SD card or an embedded ROM buffer. */
typedef struct {
    bool embedded;
    FILE *fp;
    const uint8_t *buf;
    size_t buf_size;
    size_t pos;
} track_src_t;

/* Decoder working buffers (owned by the decode loop).
 * s_readbuf lives in PSRAM (EXT_RAM_BSS_ATTR) to free ~4 KB of internal
 * DRAM — the SD-card read path is not real-time critical, so PSRAM latency
 * is harmless here. */
static track_src_t s_src;
static HMP3Decoder s_dec;
static EXT_RAM_BSS_ATTR unsigned char s_readbuf[MP3_READ_CHUNK];
static int s_bytes_left;
static int s_consumed;
static int16_t s_pcm[MP3_PCM_MAX];
static int16_t s_stereo[MP3_PCM_MAX];

static bool open_track(void)
{
    if (!s_src.embedded) {
        s_src.fp = fopen(s_path, "rb");
        if (s_src.fp == NULL) {
            ESP_LOGE(TAG, "open %s failed", s_path);
            return false;
        }
    }
    else {
        s_src.buf = _binary_Test_mp3_start;
        s_src.buf_size = (size_t)(_binary_Test_mp3_end - _binary_Test_mp3_start);
        s_src.pos = 0;
    }

    s_dec = MP3InitDecoder();
    if (s_dec == NULL) {
        ESP_LOGE(TAG, "MP3InitDecoder failed");
        if (!s_src.embedded && s_src.fp != NULL) {
            fclose(s_src.fp);
            s_src.fp = NULL;
        }
        return false;
    }
    s_bytes_left = 0;
    s_consumed = 0;
    return true;
}

static void close_track(void)
{
    if (s_dec != NULL) {
        MP3FreeDecoder(s_dec);
        s_dec = NULL;
    }
    if (!s_src.embedded && s_src.fp != NULL) {
        fclose(s_src.fp);
        s_src.fp = NULL;
    }
    hw_audio_set_player_active(false);
}

/* Read up to `want` bytes from the active source into `out`. Returns the
 * number of bytes actually read (0 at end of source). */
static int src_read(void *out, int want)
{
    if (s_src.embedded) {
        size_t remain = s_src.buf_size - s_src.pos;
        int n = (remain < (size_t)want) ? (int)remain : want;
        if (n <= 0) {
            return 0;
        }
        memcpy(out, s_src.buf + s_src.pos, (size_t)n);
        s_src.pos += (size_t)n;
        return n;
    }
    return (int)fread(out, 1, (size_t)want, s_src.fp);
}

/* Decode a single frame and stream it. Returns false on EOF/error. */
static bool decode_frame(bool *rate_set)
{
    if (s_bytes_left < 1024) {
        if (s_consumed > 0) {
            memmove(s_readbuf, s_readbuf + s_consumed, (size_t)s_bytes_left);
            s_consumed = 0;
        }
        int got = src_read(s_readbuf + s_bytes_left,
                           MP3_READ_CHUNK - s_bytes_left);
        s_bytes_left += got;
        if (got == 0 && s_bytes_left < 2) {
            return false;   /* end of file */
        }
    }

    int offset = MP3FindSyncWord(s_readbuf + s_consumed, s_bytes_left);
    if (offset < 0) {
        /* No sync word in buffer: discard and refill next call. */
        ESP_LOGD(TAG, "no sync word in %d buffered bytes, refilling",
                 s_bytes_left);
        s_consumed = 0;
        s_bytes_left = 0;
        return true;
    }
    s_consumed += offset;
    s_bytes_left -= offset;

    unsigned char *p = s_readbuf + s_consumed;
    int status = MP3Decode(s_dec, &p, &s_bytes_left, s_pcm, 0);
    s_consumed = (int)(p - s_readbuf);

    if (status != 0) {
        /* Skip one byte and resync. */
        ESP_LOGD(TAG, "MP3Decode status=%d at consumed=%d, resyncing",
                 status, s_consumed);
        if (s_consumed < MP3_READ_CHUNK - 1) {
            s_consumed++;
            s_bytes_left--;
        }
        else {
            s_consumed = 0;
            s_bytes_left = 0;
        }
        return true;
    }

    MP3FrameInfo info;
    MP3GetLastFrameInfo(s_dec, &info);
    if (!*rate_set && info.samprate > 0) {
        hw_audio_set_sample_rate((uint32_t)info.samprate);
        *rate_set = true;
        s_dbg_rate = (uint32_t)info.samprate;
        ESP_LOGD(TAG, "first frame: %u Hz, %d ch, %d kbps, %d samples/frame",
                 (unsigned)info.samprate, info.nChans, info.bitrate,
                 info.outputSamps);
    }

    s_dbg_frames++;
    if (s_dbg_frames % 50 == 0) {
        ESP_LOGD(TAG, "frame #%u consumed=%d out=%d",
                 (unsigned)s_dbg_frames, s_consumed, info.outputSamps);
    }

    if (info.nChans == 2) {
        hw_audio_write_pcm(s_pcm, (size_t)(info.outputSamps / 2));
    }
    else {
        for (int i = 0; i < info.outputSamps; i++) {
            s_stereo[2 * i] = s_pcm[i];
            s_stereo[2 * i + 1] = s_pcm[i];
        }
        hw_audio_write_pcm(s_stereo, (size_t)info.outputSamps);
    }

    return true;
}

static void decode_loop(void)
{
    for (;;) {
        if (s_new_req) {
            s_new_req = false;
            strncpy(s_path, s_new_path, sizeof(s_path) - 1);
            s_path[sizeof(s_path) - 1] = '\0';
            strncpy(s_name, s_new_name, sizeof(s_name) - 1);
            s_name[sizeof(s_name) - 1] = '\0';
            s_src.embedded = s_new_embedded;
            s_stop_req = false;
            s_pause_req = false;
        }

        if (!open_track()) {
            s_state = PLAYER_IDLE;
            return;
        }
        hw_audio_set_player_active(true);
        ESP_LOGI(TAG, "start track '%s' embedded=%d", s_name,
                 s_src.embedded);

        bool rate_set = false;
        int frame_cnt = 0;
        s_dbg_frames = 0;                 /* reset debug frame counter */
        while (!s_stop_req) {
            if (s_pause_req) {
                ulTaskNotifyTake(pdTRUE, portMAX_DELAY);
                s_pause_req = false;
                if (s_stop_req) {
                    break;
                }
                continue;
            }
            if (!decode_frame(&rate_set)) {
                break;
            }
            frame_cnt++;
        }

        ESP_LOGI(TAG, "track ended: frames=%u (~%u ms est.), %s",
                 (unsigned)frame_cnt,
                 s_dbg_rate ? (unsigned)((uint64_t)frame_cnt * 1152 /
                                         s_dbg_rate * 1000) : 0,
                 s_stop_req ? "stopped by user" : "reached EOF");
        close_track();

        if (s_new_req) {
            continue;   /* switch to the newly requested track */
        }
        break;
    }
    s_state = PLAYER_IDLE;
}

static void player_task(void *arg)
{
    (void)arg;
    for (;;) {
        ulTaskNotifyTake(pdTRUE, portMAX_DELAY);
        if (s_state == PLAYER_PLAYING) {
            decode_loop();
        }
        s_state = PLAYER_IDLE;
    }
}

void player_init(void)
{
    s_state = PLAYER_IDLE;
    s_name[0] = '\0';
    /* Debug tracing is compiled in (LOG_LOCAL_LEVEL) but off by default;
     * the settings page LOG option enables it at runtime. */
    xTaskCreate(player_task, "mp3_player", 16 * 1024, NULL, 5, &s_task);
}

int player_scan(char (*names)[MP3_NAME_LEN], int max, int *count)
{
    *count = 0;
    DIR *d = opendir("/sdcard");
    if (d != NULL) {
        struct dirent *e;
        while ((e = readdir(d)) != NULL && *count < max) {
            const char *fn = e->d_name;
            int len = (int)strlen(fn);
            if (len > 4 && strcasecmp(fn + len - 4, ".mp3") == 0) {
                strncpy(names[*count], fn, MP3_NAME_LEN - 1);
                names[*count][MP3_NAME_LEN - 1] = '\0';
                (*count)++;
            }
        }
        closedir(d);
    }
    /* The built-in ROM test track is always available, even without an SD card. */
    if (*count < max) {
        strncpy(names[*count], EMBEDDED_PREFIX " Test.mp3", MP3_NAME_LEN - 1);
        names[*count][MP3_NAME_LEN - 1] = '\0';
        (*count)++;
    }
    return 0;
}

player_state_t player_state(void)
{
    return s_state;
}

const char *player_current_name(void)
{
    return s_name;
}

void player_play(const char *name)
{
    strncpy(s_new_name, name, sizeof(s_new_name) - 1);
    s_new_name[sizeof(s_new_name) - 1] = '\0';
    if (strncmp(name, EMBEDDED_PREFIX, strlen(EMBEDDED_PREFIX)) == 0) {
        s_new_embedded = true;
    }
    else {
        s_new_embedded = false;
        snprintf(s_new_path, sizeof(s_new_path), "/sdcard/%s", name);
    }

    s_new_req = true;
    s_stop_req = true;          /* ask any current decode to stop */
    s_state = PLAYER_PLAYING;
    if (s_task != NULL) {
        xTaskNotifyGive(s_task);
    }
}

void player_toggle(void)
{
    if (s_state == PLAYER_PLAYING) {
        /* Release I2S so any ongoing hw_audio_write_pcm back-pressure loop
         * returns immediately; the decode loop sees s_pause_req next. */
        hw_audio_set_player_active(false);
        s_pause_req = true;
        s_state = PLAYER_PAUSED;
    }
    else if (s_state == PLAYER_PAUSED) {
        s_pause_req = false;
        hw_audio_set_player_active(true);  /* re-acquire I2S bus */
        s_state = PLAYER_PLAYING;
        if (s_task != NULL) {
            xTaskNotifyGive(s_task);       /* wake the decode loop */
        }
    }
}

void player_stop(void)
{
    /*
     * Release the I2S bus FIRST so the decode task's back-pressure loop
     * inside hw_audio_write_pcm() bails out immediately (it checks
     * s_player_active before and during every write). Without this, the
     * decode task stays stuck waiting for I2S to drain the ring and might
     * not see s_stop_req for hundreds of milliseconds.
     *
     * The dormant player path (when paused) is woken via the notify below.
     */
    hw_audio_set_player_active(false);
    s_stop_req = true;
    if (s_task != NULL) {
        xTaskNotifyGive(s_task);
    }
    s_state = PLAYER_IDLE;
}
